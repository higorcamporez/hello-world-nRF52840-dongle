## CMakeLists.txt
```
cmake_minimum_required(VERSION 3.20.0)
find_package(Zephyr REQUIRED HINTS $ENV{ZEPHYR_BASE})

project(hello-world-nRF52840-dongle)

target_sources(app PRIVATE src/main.c)
```

## prj.conf
```kconfig
# USB stack and CDC ACM settings
CONFIG_USB_DEVICE_STACK=y
CONFIG_USB_DEVICE_REMOTE_WAKEUP=n
CONFIG_USB_CDC_ACM=y
CONFIG_USB_DEVICE_MANUFACTURER="Nordic Semiconductor ASA"
CONFIG_USB_DEVICE_PRODUCT="nRF52840 Dongle"
CONFIG_USB_DEVICE_VID=0x1915
CONFIG_USB_DEVICE_PID=0x0001
CONFIG_USB_DEVICE_INITIALIZE_AT_BOOT=y
CONFIG_USB_DEVICE_LOG_LEVEL_OFF=y
CONFIG_USB_CDC_ACM_LOG_LEVEL_OFF=y
CONFIG_USB_CDC_ACM_RINGBUF_SIZE=2048

# Console settings
CONFIG_CONSOLE=y
CONFIG_SERIAL=y
CONFIG_UART_CONSOLE=y
CONFIG_UART_INTERRUPT_DRIVEN=y

# Logger settings
CONFIG_LOG=y
CONFIG_LOG_BACKEND_UART=y
CONFIG_LOG_MODE_DEFERRED=y
```

## nrf52840dongle_nrf52840.overlay
```dts
// To get started, press Ctrl+Space to bring up the completion menu and view the available nodes.

// You can also use the buttons in the sidebar to perform actions on nodes.
// Actions currently available include:

// * Enabling / disabling the node
// * Adding the bus to a bus
// * Removing the node
// * Connecting ADC channels

// For more help, browse the DeviceTree documentation at https://docs.zephyrproject.org/latest/guides/dts/index.html
// You can also visit the nRF DeviceTree extension documentation at https://nrfconnect.github.io/vscode-nrf-connect/devicetree/nrfdevicetree.html

/ {
	chosen {
		zephyr,console = &cdc_acm_uart0;
	};
};

&zephyr_udc0 {
	cdc_acm_uart0: cdc_acm_uart0 {
		compatible = "zephyr,cdc-acm-uart";
	};
};
```

## src/main.c
```c
#include <zephyr/kernel.h>
#include <zephyr/sys/printk.h>
#include <string.h>
#define LANG "pt-br" // supported languages ["pt-br" "nl" "en"]

void main(void)
{
        printk("nRF52840 dongle printk example!\n");
        while(1){
                if (strcmp(LANG, "en") == 0) {
                        printk("Hello World!\n");
                } else if (strcmp(LANG, "pt-br") == 0) {
                        printk("Olá Mundo!\n");
                } else if (strcmp(LANG, "nl") == 0) {
                        printk("Hallo Wereld!\n");
                } else {
                        printk("Language not supported!\n");
                        break;
                }
                k_sleep(K_MSEC(1000));
        }
}
```
